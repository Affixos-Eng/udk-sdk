## boards/arm/leaps_lc14/Kconfig.defconfig
```kconfig
# LEAPS - Low Energy Accurate Positioning System.
#
# LEAPS LC14 board configuration
#
# (c) 2024, LEAPS - All rights reserved.
# SPDX-License-Identifier: Apache-2.0

if BOARD_LEAPS_LC14

config BOARD
	default "leaps_lc14"

config BOARD_ID
	hex
	default 0x01100E12


if USB

config USB_NRFX
	default y

config USB_DEVICE_STACK
	default y

endif # USB

config IEEE802154_NRF5
	default y
	depends on IEEE802154

config BT_CTLR
	default BT

endif # BOARD_LEAPS_LC14
```

## boards/arm/leaps_lc14/leaps_lc14_defconfig
```kconfig
# LEAPS - Low Energy Accurate Positioning System.
#
# (c) 2024, LEAPS - All rights reserved.
#
CONFIG_ARM_MPU=y
CONFIG_SOC_SERIES_NRF52X=y
CONFIG_SOC_NRF52840_QIAA=y
CONFIG_BOARD_LEAPS_LC14=y

# Console
CONFIG_CONSOLE=y
CONFIG_SERIAL=y
CONFIG_UART_CONSOLE=y

# Additional board options
CONFIG_GPIO_AS_PINRESET=y

# enable pin controller
CONFIG_PINCTRL=y
```

## dts/bindings/gpio/gpio-generic.yaml
```yaml
# LEAPS - Low Energy Accurate Positioning System.
# 
# Copyright (c) 2025, LEAPS. All rights reserved.
# 
# SPDX-License-Identifier: Apache-2.0
#
---
description: GPIO GENERIC parent node
compatible: "gpio-generic"

child-binding:

    description: GPIO GENERIC child node
    properties:
       gpios:
          type: phandle-array
          required: true
       label:
          required: true
          type: string
          description: This is a representation of generic GPIO nodes
```

## west.yml
```yaml
# LEAPS - Low Energy Accurate Positioning System.
# 
# Copyright (c) 2025, LEAPS. All rights reserved.
# 
# SPDX-License-Identifier: Apache-2.0

manifest:
  self:
    path: leaps-udk-examples

  remotes:
    - name: zephyrproject-rtos
      url-base: https://github.com/zephyrproject-rtos

  projects:
    - name: zephyr
      remote: zephyrproject-rtos
      revision: v3.1.0
      import: true
```
